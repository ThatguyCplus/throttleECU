/**
 * These arguments were used when this file was generated. They will be automatically applied on subsequent loads
 * via the GUI or CLI. Run CLI with '--help' for additional information on how to override these arguments.
 * @cliArgs --device "F28004x" --part "F28004x_100PZ" --package "F28004x_100PZ" --context "system" --product "C2000WARE@26.00.00.00"
 * @v2CliArgs --device "TMS320F280041C" --package "100PZ" --context "system" --product "C2000WARE@26.00.00.00"
 * @versions {"tool":"1.27.0+4565"}
 */
